## apsta/main/Kconfig.projbuild
```kconfig
menu "Example Configuration"

    config ESP_WIFI_SSID
        string "WiFi SSID"
        default "myssid"
        help
            SSID (network name) for the example to connect to.

    config ESP_WIFI_PASSWORD
        string "WiFi Password"
        default "mypassword"
        help
            WiFi password (WPA or WPA2) for the example to use.

    config ESP_MAXIMUM_RETRY
        int "Maximum retry"
        default 5
        help
            Set the Maximum retry to avoid station reconnecting to the AP unlimited when the AP is really inexistent.

    config EXAMPLE_RMT_TX_GPIO
        int "RMT TX GPIO"
        default 48
        help
            Set the GPIO number used for transmitting the RMT signal.

    config EXAMPLE_STRIP_LED_NUMBER
        int "Number of LEDS in a strip"
        default 1
        help
            A single RGB strip contains several LEDs.        
endmenu

menu "Example Configuration AP"

    config ESP_WIFIAP_SSID
        string "WiFi SSID"
        default "myssid"
        help
            SSID (network name) for the example to connect to.

    config ESP_WIFIAP_PASSWORD
        string "WiFi Password"
        default "mypassword"
        help
            WiFi password (WPA or WPA2) for the example to use.
    config ESP_WIFIAP_CHANNEL
        int "WiFi Channel"
        range 1 13
        default 1
        help
            WiFi channel (network channel) for the example to use.

    config ESP_MAX_STA_CONN
        int "Maximal STA connections"
        default 4
        help
            Max number of the STA connects to AP.
endmenu

menu "Example Server Configuration"

    config EXAMPLE_IPV4
        bool "IPV4"
        default y

    config EXAMPLE_IPV6
        bool "IPV6"
        default n
        select EXAMPLE_CONNECT_IPV6

    config EXAMPLE_PORT
        int "Port"
        range 0 65535
        default 3333
        help
            Local port the example server will listen on.

    config EXAMPLE_KEEPALIVE_IDLE
        int "TCP keep-alive idle time(s)"
        default 5
        help
            Keep-alive idle time. In idle time without receiving any data from peer, will send keep-alive probe packet

    config EXAMPLE_KEEPALIVE_INTERVAL
        int "TCP keep-alive interval time(s)"
        default 5
        help
            Keep-alive probe packet interval time.

    config EXAMPLE_KEEPALIVE_COUNT
        int "TCP keep-alive packet retry send counts"
        default 3
        help
            Keep-alive probe packet retry count.
endmenu
menu "OLED Configuration"
    choice LCD_TYPE
        prompt "LCD module type"
        default LCD_TYPE_AUTO
        help
            The type of LCD on the evaluation board.

        config LCD_TYPE_AUTO
            bool "Auto detect"
        config LCD_TYPE_ST7789V
            bool "ST7789V (WROVER Kit v2 or v3)"
        config LCD_TYPE_ILI9341
            bool "ILI9341 (WROVER Kit v1 or DevKitJ v1)"
    endchoice

    config LCD_OVERCLOCK
        bool
        prompt "Run LCD at higher clock speed than allowed"
        default "n"
        help
            The ILI9341 and ST7789 specify that the maximum clock speed for the SPI interface is 10MHz. However,
            in practice the driver chips work fine with a higher clock rate, and using that gives a better framerate.
            Select this to try using the out-of-spec clock rate.
endmenu
```
